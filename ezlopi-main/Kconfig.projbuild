## ezlopi-main/Kconfig.projbuild
```kconfig
menu "EzloPi User Config"

    config EZPI_HEAP_ENABLE
        bool "Enable ezlopi heap"
        default n
        help
            Enables the allocation and free via ezlopi-util, helpful to track-down any memory leak in the stack

    config EZPI_DEV_TYPE_TEST
        bool "Run device in test mode"
        default n
        help
            Run the device in test mode

    config EZPI_UTIL_TRACE_EN
        bool "Enable trace component for logging"
        default y
        help
            ezlopi-util-trace component is enabled to log the outputs to the serial monitor

    config EZPI_BLE_ENABLE
        bool "Enable BLE"
        depends on IDF_TARGET_ESP32 || IDF_TARGET_ESP32C3 || IDF_TARGET_ESP32S3
        default n
        help
            Enable BLE

        config EZPI_BLE_ENABLE_PAIRING
            bool "Enable BLE pairing"
            depends on EZPI_BLE_ENABLE
            default y
            help
                Enable BLE pairing

        config EZPI_BLE_ENABLE_PASSKEY
            bool "Enable BLE pass key"
            default n
            depends on EZPI_BLE_ENABLE_PAIRING
            help
                Enable BLE pass key

        config EZPI_BLE_ENABLE_IMPROV
            bool "Enable Improv Wi-Fi provisioning over BLE"
            depends on EZPI_BLE_ENABLE && EZPI_ENABLE_WIFI
            default n
            help
                Expose the Improv Wi-Fi BLE service (00467768-6228-2272-4663-
                277478268000) so that Home Assistant and any Improv-capable
                client can put this controller on a Wi-Fi network without the
                Ezlo app and without a cloud account.

                This is off by default, and not only for caution. The legacy BLE
                advertisement carries 31 bytes, and Improv needs all of them: 3
                for the flags, 18 for its 128-bit service UUID, and 10 for the
                service data that holds the provisioning state. There is no room
                left for the device name, so when this is enabled the name moves
                to the scan response and the advertisement stops carrying it.
                That changes what a passive scanner sees, which is why it is a
                deliberate opt-in rather than the default.

                Improv itself is unauthenticated: anyone in radio range can
                write credentials. The implementation therefore only accepts a
                provisioning request while the controller is still unclaimed
                (no user_id in NVS). Once claimed, the Improv service reports
                "provisioned" and refuses to re-provision, so a neighbour cannot
                move a claimed controller onto their own network.

    config EZPI_ENABLE_IMPROV_SERIAL
        bool "Enable Improv Wi-Fi provisioning over serial"
        depends on EZPI_ENABLE_WIFI
        default n
        help
            Accept Improv Wi-Fi frames (improv-wifi.com/serial) on UART0,
            alongside the existing EzloPi serial protocol rather than instead
            of it, so that a browser running ESP Web Tools can flash this
            firmware and put the controller on Wi-Fi in the same session --
            no app, no cloud account, no second cable.

            Nothing about the port changes. The IDF console, the EzloPi serial
            protocol and ESP Web Tools all use UART0 at 115200 already, and
            115200 is fixed on the client side in any case.

            What does change is where the received bytes are inspected. Improv
            frames are binary and routinely contain 0x00 -- a bare "get current
            state" command has a data length of exactly 0x00 -- so they are
            taken out of the byte buffer before it is NUL-terminated and handed
            to the EzloPi parser as a C string. Bytes that are not part of an
            Improv frame are passed through unchanged and in order. With this
            option off, the filter is not compiled in and the reader does not
            call it.

            Improv is unauthenticated: anyone who can reach the port can write
            credentials. Over a cable that is a weaker objection than it is
            over the air, but the same rule is applied either way -- a
            provisioning request is only accepted while the controller is
            unclaimed (no user_id in NVS). Once claimed it reports
            "provisioned" and refuses. A factory reset makes it usable again.

            Off by default because it is new, and because anything that shares
            the console port deserves to be opted into rather than inherited.

    config EZPI_ENABLE_MQTT
        bool "Publish items to an MQTT broker for Home Assistant"
        default n
        help
            Publish every item this controller has to an MQTT broker, with
            Home Assistant MQTT discovery, so that the controller appears in
            Home Assistant on its own without a cloud account and without a
            custom integration.

            This is additive. It does not replace or alter the Ezlo cloud
            connection: state is taken from the same item-update broadcast the
            cloud path already produces, by registering a third observer
            alongside the two websocket transports, and writes arrive through
            the same hub.item.value.set handler the cloud uses. Nothing in
            ezlopi-core was changed to make room for it.

            Off by default. It opens an outbound connection to a broker and
            accepts commands that operate relays, which is not something to
            inherit by upgrading.

            The five settings below are fallback defaults, not the live
            configuration. Each is stored in NVS and can be changed at run time
            with the hub.mqtt.config.get, .set and .reset API methods, so
            pointing a controller at a different broker does not need a
            rebuild. A Kconfig value is used only when NVS holds nothing for
            that setting, or holds something that no longer passes validation.

            Those methods are served over the local websocket API, so runtime
            configuration also needs CONFIG_EZPI_LOCAL_WEBSOCKET_SERVER: the
            method table only exists when a websocket transport is enabled.
            With this option on and both websocket options off -- the shape the
            firmware-mqtt CI job builds -- the settings below are the only way
            to configure the broker. Changes apply on the next boot either way;
            the client is created once at startup.

            Items with no sensible Home Assistant representation -- an array,
            an opaque token -- are not published, rather than published as an
            entity that reads "unknown" forever. RGB lights, and dimmers
            paired with a switch, currently appear as their individual items
            rather than as one light entity; see the service README.

    config EZPI_MQTT_BROKER_URI
        string "MQTT broker URI"
        depends on EZPI_ENABLE_MQTT
        default ""
        help
            Broker URI, for example mqtt://192.168.1.10:1883 or
            mqtt://homeassistant.local:1883.

            Empty by default on purpose: there is no sensible default broker,
            and the service logs and stops rather than retrying an address
            that cannot work. An unreachable broker is retried forever, which
            is the right behaviour for one that is merely switched off.

            Leaving this empty and setting the URI at run time with
            hub.mqtt.config.set is the intended path for a shipped image: one
            binary, configured per site. An empty URI from both sources leaves
            the service inert rather than failing, which is also how MQTT is
            switched off again without reflashing -- set the URI to "".

            mqtts:// needs CONFIG_MQTT_TRANSPORT_SSL, which the committed
            sdkconfig.defaults files currently turn off, plus a CA certificate
            this service does not yet take. Until then, keep the broker on a
            trusted network: the credentials below cross the wire in plain
            text, as does every reading.

    config EZPI_MQTT_USERNAME
        string "MQTT username"
        depends on EZPI_ENABLE_MQTT
        default ""
        help
            Leave empty for an anonymous broker. When empty, no credentials
            are sent at all rather than empty ones, which some brokers reject
            differently from no credentials.

    config EZPI_MQTT_PASSWORD
        string "MQTT password"
        depends on EZPI_ENABLE_MQTT
        default ""
        help
            Only used when a username is set.

            This is stored in the built image in plain text, like every other
            Kconfig string. Anyone who can read the flash can read it, so use
            a broker account scoped to this controller rather than one that
            can administer the broker.

            A password set at run time with hub.mqtt.config.set goes into NVS
            instead, which is also plain text: NVS encryption requires flash
            encryption, and all four committed sdkconfig.defaults files have
            CONFIG_FLASH_ENCRYPTION_ENABLED unset. So the advice above applies
            to both paths. hub.mqtt.config.get never returns the password, only
            a passwordSet flag saying whether one exists -- which is enough for
            a settings screen to tell "leave unchanged" apart from "clear".

    config EZPI_MQTT_TOPIC_PREFIX
        string "MQTT topic prefix for this controller's own topics"
        depends on EZPI_ENABLE_MQTT
        default "ezlopi"
        help
            Root of the topics this controller publishes state and
            availability on, and listens for commands on:
            <prefix>/<node>/<object>/state, .../set and <prefix>/<node>/status.

            The node segment is derived from the MAC address, so two
            controllers sharing a broker and this prefix do not collide.

            Changing this after Home Assistant has discovered the entities
            orphans them: the old discovery payloads point at the old topics,
            so those entities go unavailable. New ones are published on the
            next connect and the stale ones have to be deleted in Home
            Assistant. That is true of changing it here and of changing it with
            hub.mqtt.config.set, which is why that method does not pretend the
            change has taken effect -- it reports rebootRequired and leaves the
            running client on the old topics until the next boot.

            Unlike the URI and the credentials, this cannot be set to an empty
            string. There is no topic to publish on without it, and accepting
            "" would produce topics beginning with "/".

    config EZPI_MQTT_DISCOVERY_PREFIX
        string "Home Assistant discovery prefix"
        depends on EZPI_ENABLE_MQTT
        default "homeassistant"
        help
            Must match Home Assistant's own mqtt discovery_prefix setting.
            "homeassistant" is the default there and almost never changed; if
            it does not match, every discovery message goes to a topic Home
            Assistant is not subscribed to and no entity ever appears, with
            nothing logged on either side to say why.

    config EZPI_CORE_ENABLE_ETH
        bool "Enable ethernet"
        depends on ETH_USE_SPI_ETHERNET
        default n
        help
            ezlopi-core-ethernet component is enabled

    config EZPI_ENABLE_WIFI
        bool "Enable Wi-Fi"
        default y
        help
            ezlopi-core-wifi component is enabled
    
    config EZPI_ENABLE_OPENTELEMETRY
        depends on EZPI_ENABLE_WIFI
        bool "Enable Open-telemetry"
        default n
        help
            Enable this for Open-telemetry feature.

        config EZPI_OPENTELEMETRY_CLOUD_ENDPOINT
            depends on EZPI_ENABLE_OPENTELEMETRY
            string "Cloud URL"
            default ""
            help
                Websocket URL that Open-telemetry logs and traces are sent to.
                Both logs and traces go to the same URL.

                There is deliberately no default: if you enable Open-telemetry
                you must supply your own collector endpoint. This used to default
                to an Ezlo internal review-staging host, which meant every build
                shipped pointing at a server nobody outside Ezlo can reach.
        

        config EZPI_OPENTELEMETRY_ENABLE_LOGS
            depends on EZPI_ENABLE_OPENTELEMETRY
            bool "Enable capturing logs"
            default n
            help
                Enable this feature to send the Open-telemetry logs to cloud

        config EZPI_OPENTELEMETRY_ENABLE_TRACES
            depends on EZPI_ENABLE_OPENTELEMETRY
            bool "Enable capturing traces"
            default n
            help
                Enable this feature to captive and send traces to cloud

    config EZPI_ENABLE_OTA
        depends on EZPI_ENABLE_WIFI || EZPI_CORE_ENABLE_ETH
        bool "Enable OTA"
        default n
        help
            Enable OTA

    choice EZPI_OTA_CA_SOURCE
        prompt "OTA server certificate verification"
        depends on EZPI_ENABLE_OTA
        default EZPI_OTA_CA_HEADER
        help
            Where the OTA client gets the root certificate it checks the
            firmware server against. This is the only thing deciding which
            hosts a hub can be updated from, so it is what has to change to
            update a hub from anywhere other than Ezlo's own server.

        config EZPI_OTA_CA_HEADER
            bool "Pinned CA from ezlopi-core-ota/ca_mios.h"
            help
                The original behaviour, and still the default so the shipped
                configuration is unchanged.

                Pins trust to a single certificate chain, which is the
                stricter choice: the hub refuses an update from any host not
                presenting that chain, even one with a valid public
                certificate.

                The header is in .gitignore, so a clean clone does not have
                it and enabling OTA this way fails the build with a message
                saying so. Supply it to pin your own CA -- including a
                private or self-signed one, which the bundle option below
                cannot verify:

                    static const char ca_mios[] =
                        "-----BEGIN CERTIFICATE-----\n"
                        ...
                        "-----END CERTIFICATE-----\n";

        config EZPI_OTA_CA_BUNDLE
            bool "ESP-IDF trusted root certificate bundle"
            depends on MBEDTLS_CERTIFICATE_BUNDLE
            help
                Verify the firmware server against the root certificates
                ESP-IDF already embeds, the way a browser would. No
                ca_mios.h is needed, so OTA builds from a clean clone.

                This is the option for hosting firmware yourself: any server
                with a certificate from a public CA works, so a GitHub
                release asset or anything behind Let's Encrypt is enough,
                with no certificate handling in the firmware at all.

                The bundle is already enabled and already in the image for
                every shipped target (CONFIG_MBEDTLS_CERTIFICATE_BUNDLE is
                on, with the common root set), so selecting this adds
                essentially no flash. It starts using bytes already carried.

                The trade-off against pinning is real and worth stating:
                trust widens from one chain to every CA in the bundle, so a
                certificate mis-issued for your host's name would be
                accepted. Pin instead if you control the CA and care.
    endchoice

    config EZPI_SERV_MDNS_EN
        bool "Enable mDNS service"
        default y
        help
            Enable mDNS service. mDNS broadcast informations of device.

    config EZPI_ENABLE_PING
        depends on EZPI_ENABLE_WIFI || EZPI_CORE_ENABLE_ETH
        bool "Enable ping"
        default y
        help
            Enable Ping

    config EZPI_LOCAL_WEBSOCKET_SERVER
        depends on (HTTPD_WS_SUPPORT && (EZPI_CORE_ENABLE_ETH || EZPI_ENABLE_WIFI ))
        bool "Enable local websocket server"
        default n
        help
            Enable local websocket server

    config EZPI_LOCAL_KEY_ANNOUNCE
        depends on EZPI_LOCAL_WEBSOCKET_SERVER
        bool "Print the generated local API key to the serial console"
        default y
        help
            A device that was never provisioned through the Ezlo app has no
            local API key, so one is generated on first boot and stored in
            NVS. This prints it once at startup so you can actually use it.

            Only a locally generated key is ever printed. A key written by
            cloud provisioning is not, because the Ezlo app already has it.

            Leave this on for a device you build yourself: without it the
            generated key is unknowable and the local API cannot be logged
            into. Turn it off if you are shipping a product on this firmware,
            and install a key of your own with EZPI_core_local_key_set().

            Anyone with the serial port can read the key while this is on.
            That is already true of anyone who can reflash the board, so it
            is not a new exposure - but it is a real one, and this is the
            switch for it.

    config EZPI_OFFLINE_LOGIN_VERIFY_USER_ID
        depends on EZPI_LOCAL_WEBSOCKET_SERVER
        bool "Verify the user id on offline login as well as the key"
        default n
        help
            hub.offline.login.ui takes a "user" and a "token". The token is
            checked against the local API key. The user field is not checked
            at all, and never has been - the verification was commented out
            with a "user-id verification disabled!" warning.

            Turn this on to also require the user id to equal the one stored
            when the device was claimed over BLE. A device that was never
            claimed has no stored id, so there is nothing to compare and the
            login proceeds on the key alone.

            Default n because no shipped build has ever enforced it, and the
            exact "user" value the Ezlo app sends on this path cannot be
            tested from this repository. The BLE auth path makes the same
            choice for the same reason - see the note at
            ezlopi_service_ble_ble_auth.c:158, which keeps a prefix match
            rather than change the behaviour of already-claimed devices.

            This is a second factor on an identifier, not on a secret. It
            does not make the local API meaningfully harder to get into; the
            local key is what does that.

    config EZPI_WEBSOCKET_CLIENT
        depends on (EZPI_CORE_ENABLE_ETH || EZPI_ENABLE_WIFI )
        bool "Enable Web-Socket client"
        default n
        help
            Enable Web-Socket client, required for connecting with cloud

    config EZPI_CORE_STATIC_BUFFER_SIZE
        depends on EZPI_WEBSOCKET_CLIENT || EZPI_LOCAL_WEBSOCKET_SERVER
        int "Static buffer size:"
        default 10240
        help
            Static buffer is used to broadcast data. Data is broadcasted by local-websocket-server and websocket-client. Default value is 10KB"

    config EZPI_SERV_ENABLE_MESHBOTS
        depends on (EZPI_WEBSOCKET_CLIENT || EZPI_LOCAL_WEBSOCKET_SERVER)
        bool "Enable meshbot service"
        default n
        help
            Enable meshbot services for scenes

        config EZPI_SERV_ENABLE_MODES
            depends on EZPI_SERV_ENABLE_MESHBOTS
            bool "Enable mode services"
            default n
            help
                Enable mode services

    config EZPI_ENABLE_LED_INDICATOR
        bool "Enable indicator LED available in the device"
        default y
        help
            Enable indicator LED available in the device

    config EZPI_ENABLE_SYSTEM_TEMPERATURE
        depends on IDF_TARGET_ESP32S3 || IDF_TARGET_ESP32C3 || IDF_TARGET_ESP32S2
        bool "Enable system temperature monitoring uisng inbuilt temperature sensor"
        default n
        help
            Enable system temperature monitoring uisng inbuilt temperature sensor
    
    choice 
        prompt "Enable provisionsing method"
        default EZPI_ENABLE_UART_PROVISIONING

        config EZPI_ENABLE_UART_PROVISIONING
            bool "Enable UART provisioning"
            default y
            help
                Enable provisioning and monitoring via UART   

        config EZPI_ENABLE_CDC_PROVISIONING
            depends on (IDF_TARGET_ESP32S3 || IDF_TARGET_ESP32S2) && TINYUSB
            bool "Enable CDC provisioning"
            default n
            help 
                Enable CDC provisioning
    endchoice 

    menu "EzloPi mDNS config"
        depends on EZPI_SERV_MDNS_EN

        config EZPI_MDNS_ENABLE_EXTRA_SERVICES
            bool "mDNS enable extra services"
            default n
            help
                Enable extra services such as manufacturer, brand, etc.

        config EZPI_MDNS_ENABLE_MANUFACTURER_SERVICE
            bool "mDNS enable manufacturer service"
            depends on EZPI_MDNS_ENABLE_EXTRA_SERVICES
            default n
            help
                Enable manufacturer extra service in ezlopi mDNS

        config EZPI_MDNS_ENABLE_BRAND_SERVICE
            bool "mDNS enable brand service"
            depends on EZPI_MDNS_ENABLE_EXTRA_SERVICES
            default n
            help
                Enable brand extra service in ezlopi mDNS

        config EZPI_MDNS_ENABLE_MODEL_SERVICE
            bool "mDNS enable model service"
            depends on EZPI_MDNS_ENABLE_EXTRA_SERVICES
            default n
            help
                Enable model extra service in ezlopi mDNS

        config EZPI_MDNS_ENABLE_NAME_SERVICE
            bool "mDNS enable name service"
            depends on EZPI_MDNS_ENABLE_EXTRA_SERVICES
            default n
            help
                Enable name extra service in ezlopi mDNS
    endmenu

endmenu
```
